/*
 * Modbus.c
 *
 *  Created on: 2019年8月17日
 *      Author: Breuning
 */
#include "Modbus.h"
#include <string.h>
#include "Cloud.h"
#include "tim.h"
#include "LED.h"
#include "usart.h"

RS485_UART RS485Uart=
{
	.RX_ProcessSta = 0,
	.RX_State = 0,
	.RX_Len = 0,
};
uint8_t RS485_RX[RS485_RX_LEN] = { 0 };
uint8_t ModbusBuf[RS485_RX_LEN]= { 0 };
uint8_t ModbusBuf_TX[RS485_TX_LEN]= { 0 };


MODBUS Modbus={0};

void MODBUS_Save485Data(void)
{
	if(RS485Uart.RX_State == RS485_RX_IMCOMPLETE)
	{
		ModbusBuf[RS485Uart.RX_Len++] = RS485_RX[0];

		if(ModbusBuf[SLAVE_DEV_ADDR_NUM] != SLAVE_DEV_ADDR_VALUE)
		{
			RS485Uart.RX_Len=0;
			return;
		}

		if((ModbusBuf[FUNC_NUM] != WRITE_FUN_VALUE)&&(ModbusBuf[FUNC_NUM] != READ_FUN_VALUE)&&(RS485Uart.RX_Len == 2))
		{
			RS485Uart.RX_Len=0;
			return;
		}

		switch(ModbusBuf[FUNC_NUM])
		{
			case WRITE_FUN_VALUE:
				if(RS485Uart.RX_Len>=RS485_RX_WRITE_COUNT)
				{
					RS485Uart.RX_Len=0;
					RS485Uart.RX_State = RS485_RX_WRITE_COMPLETE;
					RS485Uart_RX_TX_Switch(TRANSMIT);                 		//485接收完毕，发送打开
				}
				break;
			case READ_FUN_VALUE:
				if(RS485Uart.RX_Len>=RS485_RX_READ_COUNT)
				{
					RS485Uart.RX_Len=0;
					RS485Uart.RX_State = RS485_RX_READ_COMPLETE;
					RS485Uart_RX_TX_Switch(TRANSMIT);                 		//485接收完毕，发送打开
				}
				break;
			default:
				break;
		}

	}

}

void ModbusDataRecv(void)
{
	if(RS485Uart.RX_State == RS485_RX_WRITE_COMPLETE)
	{

		if(ModbusDataReceive_TimerFlag == TRUE)              		//通过TIM2设置为每5秒进行一次对收到Modbus数据包的解析
		{
			ModbusDataAnalysis(ModbusBuf,RS485_RX_WRITE_COUNT);

			LED2_RS485_Blink();

			memset(ModbusBuf,0,sizeof(ModbusBuf));
			RS485Uart_RX_TX_Switch(RECEIVE);                		//485接收打开，发送截止
			RS485Uart.RX_State = RS485_RX_IMCOMPLETE;
			ModbusDataReceive_TimerFlag = FALSE;
		}
	}

	if(RS485Uart.RX_State == RS485_RX_READ_COMPLETE)
	{
		ModBus_MCUID_Ack(ModbusBuf,RS485_RX_READ_COUNT);



		memset(ModbusBuf,0,sizeof(ModbusBuf));
		RS485Uart_RX_TX_Switch(RECEIVE);                		//485接收打开，发送截止
		RS485Uart.RX_State = RS485_RX_IMCOMPLETE;
	}

}

void ModbusDataAnalysis(uint8_t *modbusbuf,uint8_t bufLen)
{

	if(bufLen < RX_EFCT_DATA_OFFSET_NUM)                            //接收到的一帧数据长度肯定大于7
	{
		return;
	}

	Modbus.CRC_VAL= (modbusbuf[bufLen-2]<<8)|modbusbuf[bufLen-1];  //数据包中的CRC校验值
	Modbus.CHECK_CRC= CRC16(modbusbuf,bufLen-2);                   //计算得到的CRC校验值
	if(Modbus.CRC_VAL != Modbus.CHECK_CRC)
	{
	  Modbus.ERR_CODE = CRC_ERR;
	  return;
	}

	else
	{
		Modbus.DEV_ADDR = modbusbuf[SLAVE_DEV_ADDR_NUM];                                    //从机地址
        Modbus.FUN_CODE = modbusbuf[FUNC_NUM];                                              //功能码
		Modbus.REG_ADDR = (modbusbuf[REG_ADDR_HIGH_NUM]<<8)|modbusbuf[REG_ADDR_LOW_NUM];    //寄存器起始地址
		Modbus.REG_QUAN  = (modbusbuf[REG_NUM_HIGH_NUM]<<8)|modbusbuf[REG_NUM_LOW_NUM];     //寄存器数量
        if(Modbus.DEV_ADDR == SLAVE_DEV_ADDR_VALUE)
        {
			switch(Modbus.FUN_CODE)
			{
				case READ_FUN_VALUE:
					//memcpy(Modbus.RX_DATA,(uint8_t*)(modbusbuf+RX_EFCT_DATA_OFFSET_NUM),Modbus.REG_CNT);
					//ReadData(&Modbus,Modbus.REG_CNT/2);
					//Modbus.ERR_Code=0;
					break;
				case WRITE_FUN_VALUE:
					if(Modbus.REG_ADDR != 0)                    //寄存器起始地址需为0，即数据从地址0开始写
						return;
					memcpy(Modbus.RX_DATA,(uint8_t*)(modbusbuf+RX_EFCT_DATA_OFFSET_NUM),(Modbus.REG_QUAN)*2);   //将第7个字节后的数据值放到Modbus.RX_DATA
					WriteMultiRegister(Modbus.RX_DATA);
					break;
				default:
					Modbus.FUN_CODE = FUN_ERR;
					break;
			}
		}
        else
        {
            Modbus.FUN_CODE = FUN_ERR;
        }
    }
}

void WriteMultiRegister(uint8_t *databuf)
{
	hcloud.ibsRealData[0]  = ((databuf[0]<<8)|databuf[1]);      	//年
	hcloud.ibsRealData[1]  = ((databuf[2]<<8)|databuf[3]);      	//月
	hcloud.ibsRealData[2]  = ((databuf[4]<<8)|databuf[5]);      	//日
	hcloud.ibsRealData[3]  = ((databuf[6]<<8)|databuf[7]);      	//时
	hcloud.ibsRealData[4]  = ((databuf[8]<<8)|databuf[9]);      	//分
	hcloud.ibsRealData[5]  = ((databuf[10]<<8)|databuf[11]);    	//秒
	hcloud.ibsRealData[6]  = ((databuf[12]<<8)|databuf[13])/10.0; 	//室外温度
	hcloud.ibsRealData[7]  = ((databuf[14]<<8)|databuf[15])/10.0; 	//平均温度
	hcloud.ibsRealData[8]  = ((databuf[16]<<8)|databuf[17])/10.0;	//温度1
	hcloud.ibsRealData[9]  = ((databuf[18]<<8)|databuf[19])/10.0;	//湿度
	hcloud.ibsRealData[10] = ((databuf[20]<<8)|databuf[21])/10.0;   //温度2
	hcloud.ibsRealData[11] = ((databuf[22]<<8)|databuf[23])/10.0;   //温度3
	hcloud.ibsRealData[12] = ((databuf[24]<<8)|databuf[25])/10.0;   //水温
	hcloud.ibsRealData[13] = ((databuf[26]<<8)|databuf[27]);        //负压
	hcloud.ibsRealData[14] = ((databuf[28]<<8)|databuf[29]);        //CO2
	hcloud.ibsRealData[15] = ((databuf[30]<<8)|databuf[31]);        //NH3
	hcloud.ibsRealData[16] = ((databuf[32]<<8)|databuf[33]);        //当前日龄
	hcloud.ibsRealData[17] = ((databuf[34]<<8)|databuf[35])/10.0;   //目标温度
	hcloud.ibsRealData[18] = ((databuf[36]<<8)|databuf[37]);        //风机状态              12位
	hcloud.ibsRealData[19] = ((databuf[38]<<8)|databuf[39]);        //小窗状态                4位
	hcloud.ibsRealData[20] = ((databuf[40]<<8)|databuf[41]);        //加热状态                4位
	hcloud.ibsRealData[21] = ((databuf[42]<<8)|databuf[43]);        //湿帘状态                3位
	hcloud.ibsRealData[22] = ((databuf[44]<<8)|databuf[45]);        //报警状态                1位
	hcloud.ibsRealData[23] = ((databuf[46]<<8)|databuf[47]);        //自动状态     1+1+1+1位
}

void ModBus_MCUID_Ack(uint8_t *modbusbuf,uint8_t bufLen)
{
	uint8_t i;

	Modbus.CRC_VAL= (modbusbuf[bufLen-2]<<8)|modbusbuf[bufLen-1];  //数据包中的CRC校验值
	Modbus.CHECK_CRC= CRC16(modbusbuf,bufLen-2);                   //计算得到的CRC校验值
	if(Modbus.CRC_VAL != Modbus.CHECK_CRC)
	{
	  Modbus.ERR_CODE = CRC_ERR;
	  return;
	}

	else
	{
		Get_MCUUID();
		ModbusBuf_TX[SLAVE_DEV_ADDR_NUM] = SLAVE_DEV_ADDR_VALUE;
		ModbusBuf_TX[FUNC_NUM ] = READ_FUN_VALUE;
		ModbusBuf_TX[2] = 48;

        for(i = 0; i < 24; i++)
        {
        	ModbusBuf_TX[i*2+4] = (uint8_t)hcloud.McuId[i];
        }
        ModbusBuf_TX[51] = CRC16(ModbusBuf_TX,51) >> 8;
        ModbusBuf_TX[52] = CRC16(ModbusBuf_TX,51) & 0xff;

        HAL_UART_Transmit(&huart4, (uint8_t *)ModbusBuf_TX, sizeof(ModbusBuf_TX), 1000);      //将MCUID通过modbus协议发送至PLC
	}

}

void RS485Uart_RX_TX_Switch(RS485_STATE RS485state)
{
	if(RS485state == TRANSMIT)
		HAL_GPIO_WritePin(RS485_SEL_GPIO_Port, RS485_SEL_Pin, GPIO_PIN_SET);		//拉高RS485_SEL脚，RS485为发送状态
	if(RS485state == RECEIVE)
		HAL_GPIO_WritePin(RS485_SEL_GPIO_Port, RS485_SEL_Pin, GPIO_PIN_RESET);		//拉低RS485_SEL脚，RS485为接收状态
}


const unsigned char auchCRCHi[] =
 {
    0x00,0xC1,0x81,0x40,0x01,0xC0,0x80,0x41,
    0x01,0xC0,0x80,0x41,0x00,0xC1,0x81,0x40,
    0x01,0xC0,0x80,0x41,0x00,0xC1,0x81,0x40,
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    0x01,0xC0,0x80,0x41,0x00,0xC1,0x81,0x40
};

const unsigned char auchCRCLo[] =
{
    0x00,0xC0,0xC1,0x01,0xC3,0x03,0x02,0xC2,
    0xC6,0x06,0x07,0xC7,0x05,0xC5,0xC4,0x04,
    0xCC,0x0C,0x0D,0xCD,0x0F,0xCF,0xCE,0x0E,
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    0x82,0x42,0x43,0x83,0x41,0x81,0x80,0x40
};

unsigned int CRC16(unsigned char *puchMsg, unsigned int usDataLen)
{
	unsigned char uchCRCHi = 0xFF;
	unsigned char uchCRCLo = 0xFF;
	unsigned char uIndex ;

	while (usDataLen--)
	{
		uIndex = uchCRCHi ^ *puchMsg++;
		uchCRCHi = uchCRCLo ^ auchCRCHi[uIndex];
		uchCRCLo = auchCRCLo[uIndex];
	}
	return (uchCRCHi << 8 | uchCRCLo);
}





